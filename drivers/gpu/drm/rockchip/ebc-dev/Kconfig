## drivers/gpu/drm/rockchip/ebc-dev/Kconfig
```kconfig
# SPDX-License-Identifier: GPL-2.0

menuconfig ROCKCHIP_EBC_DEV
	bool "Rockchip eBook Device Driver"
	select DMA_SHARED_BUFFER
	help
	Rockchip eBook Device Dirver could help to driver the electronic ink screen.

config EPD_TPS65185_SENSOR
    bool "ebook pmic Tps65185"
    depends on ROCKCHIP_EBC_DEV
    default y

config EPD_SY7636A_PMIC
	bool "EBOOK PMIC SY7636A Support"
	depends on ROCKCHIP_EBC_DEV
	default y
	help
	  If you say yes here you get support for the Silergy SY7636A PMIC.

config EPD_FP9931_PMIC
	bool "EBOOK PMIC FP9931 Support"
	depends on ROCKCHIP_EBC_DEV
	default y
	help
	  If you say yes here you get support for the Fitipower FP9931 PMIC.

config EPD_FP9936_PMIC
	bool "EBOOK PMIC FP9936 Support"
	depends on ROCKCHIP_EBC_DEV
	default y
	help
	  If you say yes here you get support for the Fitipower FP9936 PMIC.

config EPD_G2195_PMIC
	bool "EBOOK PMIC G2195 Support"
	depends on ROCKCHIP_EBC_DEV
	default y
	help
	  If you say yes here you get support for the GMT G2195 PMIC.
```
