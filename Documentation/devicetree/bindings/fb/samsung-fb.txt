## backports/Kconfig
```kconfig
config BACKPORT_INTEGRATE
	bool
	def_bool y

config BACKPORT_DIR
	string
	default "backports"

config BACKPORT_VERSION
	string
	default "backports-20150222-0-g2745ccd"

config BACKPORT_KERNEL_VERSION
	string
	default "next-20150222-0-g53e418f1"

config BACKPORT_KERNEL_NAME
	string
	default "Linux"

menuconfig BACKPORT_LINUX
	bool "Backport Linux next-20150222-0-g53e418f1 (backports backports-20150222-0-g2745ccd)"
	default n
	---help---
	  Enabling this will let give you the opportunity to use features and
	  drivers backported from Linux next-20150222-0-g53e418f1
	  on the kernel your are using. This is experimental and you should
	  say no unless you'd like to help test things or want to help debug
	  this should we run into any issues.

if BACKPORT_LINUX

source "$BACKPORT_DIR/Kconfig.versions"
source "$BACKPORT_DIR/Kconfig.sources"
source "$BACKPORT_DIR/Kconfig.realtek"

endif # BACKPORT_LINUX
```

## backports/drivers/media/mmc/siano/Kconfig
```kconfig
#
# Siano Mobile Silicon Digital TV device configuration
#

config BACKPORT_SMS_SDIO_DRV
	tristate "Siano SMS1xxx based MDTV via SDIO interface"
	depends on !SMS_SDIO_DRV
	depends on BACKPORT_DVB_CORE && HAS_DMA
	depends on MMC
	depends on !RC_CORE || BACKPORT_RC_CORE
	select BACKPORT_MEDIA_COMMON_OPTIONS
	select BACKPORT_SMS_SIANO_MDTV
	---help---
	  Choose if you would like to have Siano's support for SDIO interface
```

## backports/drivers/media/usb/siano/Kconfig
```kconfig
#
# Siano Mobile Silicon Digital TV device configuration
#

config BACKPORT_SMS_USB_DRV
	tristate "Siano SMS1xxx based MDTV receiver"
	depends on !SMS_USB_DRV
	depends on BACKPORT_DVB_CORE && HAS_DMA
	depends on !RC_CORE || BACKPORT_RC_CORE
	select BACKPORT_MEDIA_COMMON_OPTIONS
	select BACKPORT_SMS_SIANO_MDTV
	---help---
	  Choose if you would like to have Siano's support for USB interface
```

## backports/net/6lowpan/Kconfig
```kconfig
menuconfig BACKPORT_6LOWPAN
	tristate "6LoWPAN Support"
	depends on !6LOWPAN
	depends on IPV6
	---help---
	  This enables IPv6 over Low power Wireless Personal Area Network -
	  "6LoWPAN" which is supported by IEEE 802.15.4 or Bluetooth stacks.

menuconfig BACKPORT_6LOWPAN_NHC
	tristate "Next Header Compression Support"
	depends on !6LOWPAN_NHC
	depends on BACKPORT_6LOWPAN
	default y
	---help---
	  Support for next header compression.

if BACKPORT_6LOWPAN_NHC

config BACKPORT_6LOWPAN_NHC_DEST
	tristate "Destination Options Header Support"
	depends on !6LOWPAN_NHC_DEST
	default y
	---help---
	  6LoWPAN IPv6 Destination Options Header compression according to
	  RFC6282.

config BACKPORT_6LOWPAN_NHC_FRAGMENT
	tristate "Fragment Header Support"
	depends on !6LOWPAN_NHC_FRAGMENT
	default y
	---help---
	  6LoWPAN IPv6 Fragment Header compression according to RFC6282.

config BACKPORT_6LOWPAN_NHC_HOP
	tristate "Hop-by-Hop Options Header Support"
	depends on !6LOWPAN_NHC_HOP
	default y
	---help---
	  6LoWPAN IPv6 Hop-by-Hop Options Header compression according to
	  RFC6282.

config BACKPORT_6LOWPAN_NHC_IPV6
	tristate "IPv6 Header Support"
	depends on !6LOWPAN_NHC_IPV6
	default y
	---help---
	  6LoWPAN IPv6 Header compression according to RFC6282.

config BACKPORT_6LOWPAN_NHC_MOBILITY
	tristate "Mobility Header Support"
	depends on !6LOWPAN_NHC_MOBILITY
	default y
	---help---
	  6LoWPAN IPv6 Mobility Header compression according to RFC6282.

config BACKPORT_6LOWPAN_NHC_ROUTING
	tristate "Routing Header Support"
	depends on !6LOWPAN_NHC_ROUTING
	default y
	---help---
	  6LoWPAN IPv6 Routing Header compression according to RFC6282.

config BACKPORT_6LOWPAN_NHC_UDP
	tristate "UDP Header Support"
	depends on !6LOWPAN_NHC_UDP
	default y
	---help---
	  6LoWPAN IPv6 UDP Header compression according to RFC6282.

endif
```

## drivers/Kconfig
```kconfig
# SPDX-License-Identifier: GPL-2.0
menu "Device Drivers"

# Keep I/O buses first

source "drivers/amba/Kconfig"
source "drivers/eisa/Kconfig"
source "drivers/pci/Kconfig"
source "drivers/cxl/Kconfig"
source "drivers/pcmcia/Kconfig"
source "drivers/rapidio/Kconfig"


source "drivers/base/Kconfig"

source "drivers/bus/Kconfig"

source "drivers/connector/Kconfig"

source "drivers/firmware/Kconfig"

source "drivers/gnss/Kconfig"

source "drivers/mtd/Kconfig"

source "drivers/of/Kconfig"

source "drivers/parport/Kconfig"

source "drivers/pnp/Kconfig"

source "drivers/block/Kconfig"

source "drivers/nvme/Kconfig"

source "drivers/misc/Kconfig"

source "drivers/scsi/Kconfig"

source "drivers/ata/Kconfig"

source "drivers/md/Kconfig"

source "drivers/target/Kconfig"

source "drivers/message/fusion/Kconfig"

source "drivers/firewire/Kconfig"

source "drivers/macintosh/Kconfig"

source "drivers/net/Kconfig"

source "drivers/isdn/Kconfig"

# input before char - char/joystick depends on it. As does USB.

source "drivers/input/Kconfig"

source "drivers/char/Kconfig"

source "drivers/i2c/Kconfig"

source "drivers/i3c/Kconfig"

source "drivers/spi/Kconfig"

source "drivers/spmi/Kconfig"

source "drivers/hsi/Kconfig"

source "drivers/pps/Kconfig"

source "drivers/ptp/Kconfig"

source "drivers/pinctrl/Kconfig"

source "drivers/gpio/Kconfig"

source "drivers/w1/Kconfig"

source "drivers/power/Kconfig"

source "drivers/hwmon/Kconfig"

source "drivers/thermal/Kconfig"

source "drivers/watchdog/Kconfig"

source "drivers/ssb/Kconfig"

source "drivers/bcma/Kconfig"

source "drivers/mfd/Kconfig"

source "drivers/regulator/Kconfig"

source "drivers/media/Kconfig"

source "drivers/video/Kconfig"

source "sound/Kconfig"

source "drivers/hid/Kconfig"

source "drivers/usb/Kconfig"

source "drivers/mmc/Kconfig"

source "drivers/ufs/Kconfig"

source "drivers/memstick/Kconfig"

source "drivers/leds/Kconfig"

source "drivers/accessibility/Kconfig"

source "drivers/infiniband/Kconfig"

source "drivers/edac/Kconfig"

source "drivers/rtc/Kconfig"

source "drivers/dma/Kconfig"

source "drivers/dma-buf/Kconfig"

source "drivers/dca/Kconfig"

source "drivers/auxdisplay/Kconfig"

source "drivers/uio/Kconfig"

source "drivers/vfio/Kconfig"

source "drivers/vlynq/Kconfig"

source "drivers/virt/Kconfig"

source "drivers/virtio/Kconfig"

source "drivers/vdpa/Kconfig"

source "drivers/vhost/Kconfig"

source "drivers/hv/Kconfig"

source "drivers/xen/Kconfig"

source "drivers/greybus/Kconfig"

source "drivers/comedi/Kconfig"

source "drivers/staging/Kconfig"

source "drivers/platform/Kconfig"

source "drivers/clk/Kconfig"

source "drivers/hwspinlock/Kconfig"

source "drivers/clocksource/Kconfig"

source "drivers/mailbox/Kconfig"

source "drivers/iommu/Kconfig"

source "drivers/remoteproc/Kconfig"

source "drivers/rpmsg/Kconfig"

source "drivers/soundwire/Kconfig"

source "drivers/soc/Kconfig"

source "drivers/devfreq/Kconfig"

source "drivers/extcon/Kconfig"

source "drivers/memory/Kconfig"

source "drivers/iio/Kconfig"

source "drivers/ntb/Kconfig"

source "drivers/vme/Kconfig"

source "drivers/pwm/Kconfig"

source "drivers/irqchip/Kconfig"

source "drivers/ipack/Kconfig"

source "drivers/reset/Kconfig"

source "drivers/phy/Kconfig"

source "drivers/powercap/Kconfig"

source "drivers/mcb/Kconfig"

source "drivers/perf/Kconfig"

source "drivers/ras/Kconfig"

source "drivers/thunderbolt/Kconfig"

source "drivers/android/Kconfig"

source "drivers/gpu/trace/Kconfig"

source "drivers/nvdimm/Kconfig"

source "drivers/dax/Kconfig"

source "drivers/nvmem/Kconfig"

source "drivers/hwtracing/Kconfig"

source "drivers/fpga/Kconfig"

source "drivers/fsi/Kconfig"

source "drivers/tee/Kconfig"

source "drivers/mux/Kconfig"

source "drivers/opp/Kconfig"

source "drivers/visorbus/Kconfig"

source "drivers/siox/Kconfig"

source "drivers/slimbus/Kconfig"

source "drivers/interconnect/Kconfig"

source "drivers/counter/Kconfig"

source "drivers/most/Kconfig"

config AMLOGIC_DRIVER
	bool "Amlogic Peripheral drivers"
	default n
	help
	  this option is provided for control amlogic
	  drivers, if you want to use amlogic driver
	  please open it.
	  Note: All amlogic driver should be placed in
	  directory $(COMMON_DRIVERS_DIR)/drivers/

if AMLOGIC_DRIVER
config AMLOGIC_BREAK_GKI_20
	bool "Amlogic Break GKI 2.0"
	default n
	help
	  this option is provide for control Break GKI 2.0,
	  if you want to break gki2.0 rule, should enable it,
	  all break gki2.0 modify should be depends on this option

config AMLOGIC_BREAK_GKI
	bool "Amlogic Break GKI"
	select AMLOGIC_BREAK_GKI_20
	default n
	help
	  this option is provide for control Break GKI,
	  if you want to debug driver temporarily, should enable it,
	  export function or variable with this config,
	  and the driver Kconfig depends on this option

config AMLOGIC_MODIFY
	bool "Amlogic modify for kernel code"
	default n
	help
	  This option is set up for AMLOGIC modify of standard
	  kernel source code. All modify of kernel standard code
	  should be wrapped by this config

config AMLOGIC_IN_KERNEL_MODULES
	bool "Amlogic Drivers in build or extra build"
	default n
	help
	  this option is provided for control amlogic
	  drivers in build or extra build, if you want
	  to in build, should enable; if want to extra
	  build, should disable

config AMLOGIC_KERNEL_VERSION
	int "Amlogic Kernel Version"
	default 14515
	help
	  kernel from android14-5.15
	  so the default value is 14515
	  the driver uses it to adapt different kernel versions

if AMLOGIC_IN_KERNEL_MODULES
source "$(COMMON_DRIVERS_DIR)/drivers/Kconfig"
source "$(COMMON_DRIVERS_DIR)/sound/Kconfig"
source "$(COMMON_DRIVERS_DIR)/samples/Kconfig"
endif
endif
endmenu
```

## drivers/amlogic/Kconfig
```kconfig
#
# Amlogic driver configuration
#
menu "Amlogic Device Drivers"

source "drivers/amlogic/cec/Kconfig"

source "drivers/amlogic/clocksource/Kconfig"

source "drivers/amlogic/uart/Kconfig"

source "drivers/amlogic/cpu_version/Kconfig"

source "drivers/amlogic/iomap/Kconfig"

source "drivers/amlogic/pinctrl/Kconfig"

source "drivers/amlogic/usb/Kconfig"

source "drivers/amlogic/i2c/Kconfig"

source "drivers/amlogic/hdmi/Kconfig"

source "drivers/amlogic/rtc/Kconfig"

source "drivers/amlogic/vrtc/Kconfig"

source "drivers/amlogic/irblaster/Kconfig"

source "drivers/amlogic/aml_debug/Kconfig"

source "drivers/amlogic/reg_access/Kconfig"

source "drivers/amlogic/power/Kconfig"

source "drivers/amlogic/ethernet/Kconfig"

source "drivers/amlogic/mmc/Kconfig"

source "drivers/amlogic/vpu/Kconfig"

source "drivers/amlogic/ion_dev/Kconfig"

source "drivers/amlogic/display/Kconfig"

source "drivers/amlogic/led/Kconfig"

source "drivers/amlogic/canvas/Kconfig"

source "drivers/amlogic/clk/Kconfig"

source "drivers/amlogic/secmon/Kconfig"

source "drivers/amlogic/securitykey/Kconfig"

source "drivers/amlogic/amports/Kconfig"

source "drivers/amlogic/deinterlace/Kconfig"

source "drivers/amlogic/vfm/Kconfig"

source "drivers/amlogic/efuse/Kconfig"

source "drivers/amlogic/key_manage/Kconfig"

source "drivers/amlogic/amaudio/Kconfig"

source "drivers/amlogic/amaudio2/Kconfig"

source "drivers/amlogic/audiodsp/Kconfig"

source "drivers/amlogic/ppmgr/Kconfig"

source "drivers/amlogic/wifi/Kconfig"

source "drivers/amlogic/reset/Kconfig"

source "drivers/amlogic/bluetooth/Kconfig"

source "drivers/amlogic/ionvideo/Kconfig"

source "drivers/amlogic/video_dev/Kconfig"

source "drivers/amlogic/tvin/Kconfig"

source "drivers/amlogic/amvecm/Kconfig"

source "drivers/amlogic/amlnf/Kconfig"

source "drivers/amlogic/input/Kconfig"

source "drivers/amlogic/cpufreq/Kconfig"

source "drivers/amlogic/pm/Kconfig"

source "drivers/amlogic/dvb_tv/Kconfig"

source "drivers/amlogic/mailbox/Kconfig"

source "drivers/amlogic/rdma/Kconfig"

source "drivers/amlogic/thermal/Kconfig"

source "drivers/amlogic/audinfo_kernel/Kconfig"

source "drivers/amlogic/instaboot/Kconfig"

source "drivers/amlogic/camera/Kconfig"

source "drivers/amlogic/codec_mm/Kconfig"

source "drivers/amlogic/watchdog/Kconfig"

source "drivers/amlogic/pwm/Kconfig"

endmenu
```

## drivers/amlogic/cec/Kconfig
```kconfig
menu "AO CEC Support"

config AML_AO_CEC
	boolean "HDMI AO cec driver support"
	help
		HDMI AO cec driver provide cec support on Amlogic SOC chips, you can
		use this driver to implement cec features on TV/MBOX

endmenu
```

## drivers/amlogic/hdmi/Kconfig
```kconfig
#HDMITX

menu "HDMI TX Support"

config AML_HDMI_TX
        boolean "HDMI TX Output Enable"
        default n
        select SWITCH
        select AM_DISPLAY_MODULE

choice
        prompt "HDMI TX Version Select"
        depends on AML_HDMI_TX
        default AML_HDMI_TX_20

config AML_HDMI_TX_20
        boolean "HDMI 2.0"
        help
                hdmitx 2.0 output enable. It should be enalbe if board have hdmi 2.0 out interface

config AML_HDMI_TX_14
        boolean "HDMI 1.4"
        help
                hdmitx 1.4 output enable. It should be enalbe if board have hdmi 1.4 out interface

endchoice

if AML_HDMI_TX_14

config AML_HDMI_TX_HDCP
        boolean "HDMI HDCP Enable"
        default n
        help
                hdmitx hdcp enable, it should be enalbe if board burned hdmitx hdcp keys
endif

if AML_HDMI_TX_20
if !AML_AO_CEC
config AML_HDMI_TX_NEW_CEC_DRIVER
        bool "HDMI new CEC driver"
        default n
        help
                hdmitx uses new CEC driver
endif
endif

endmenu
```

## drivers/amlogic/smc_access/Kconfig
```kconfig
# Amlogic DEBUG
#
config AML_SMC_ACCESS
    bool "Amlogic SMC call and JTAG enable from userspace support"
    default m
    help
      This is the Amlogic debug sysfs interface driver using debugfs interface
```

## drivers/hardkernel/Kconfig
```kconfig
menu "ODROID Specific Hardware"

config ODROID_SYSFS
	bool "Hardkernel ODROID sysfs Support"
	default y
	help
	   Hardkernel sysfs
endmenu
```
