## drivers/media/platform/s5p-tv/Kconfig
```kconfig
# drivers/media/platform/s5p-tv/Kconfig
#
# Copyright (c) 2010-2011 Samsung Electronics Co., Ltd.
#	http://www.samsung.com/
# Tomasz Stanislawski <t.stanislaws@samsung.com>
#
# Licensed under GPL

config VIDEO_SAMSUNG_S5P_TV
	bool "Samsung TV driver for S5P platform (experimental)"
	depends on PLAT_S5P && PM_RUNTIME
	depends on EXPERIMENTAL
	default n
	---help---
	  Say Y here to enable selecting the TV output devices for
	  Samsung S5P platform.

if VIDEO_SAMSUNG_S5P_TV

config VIDEO_SAMSUNG_S5P_HDMI
	tristate "Samsung HDMI Driver"
	depends on VIDEO_V4L2
	depends on VIDEO_SAMSUNG_S5P_TV
	select VIDEO_SAMSUNG_S5P_HDMIPHY
	help
	  Say Y here if you want support for the HDMI output
	  interface in S5P Samsung SoC. The driver can be compiled
	  as module. It is an auxiliary driver, that exposes a V4L2
	  subdev for use by other drivers. This driver requires
	  hdmiphy driver to work correctly.

config VIDEO_SAMSUNG_S5P_HDMI_DEBUG
	bool "Enable debug for HDMI Driver"
	depends on VIDEO_SAMSUNG_S5P_HDMI
	default n
	help
	  Enables debugging for HDMI driver.

config VIDEO_SAMSUNG_S5P_HDMI_CEC
	tristate "Enable CEC support for HDMI Driver"
	depends on VIDEO_SAMSUNG_S5P_HDMI
	default n
	help
	  Enables CEC over the HDMI driver.
	  CEC enables tv-control, and reception of tv-remote
	  control commands over the HDMI interface

config VIDEO_SAMSUNG_S5P_HDMIPHY
	tristate "Samsung HDMIPHY Driver"
	depends on VIDEO_DEV && VIDEO_V4L2 && I2C
	depends on VIDEO_SAMSUNG_S5P_TV
	help
	  Say Y here if you want support for the physical HDMI
	  interface in S5P Samsung SoC. The driver can be compiled
	  as module. It is an I2C driver, that exposes a V4L2
	  subdev for use by other drivers.

config VIDEO_SAMSUNG_S5P_SII9234
	tristate "Samsung SII9234 Driver"
	depends on VIDEO_DEV && VIDEO_V4L2 && I2C
	depends on VIDEO_SAMSUNG_S5P_TV
	help
	  Say Y here if you want support for the MHL interface
	  in S5P Samsung SoC. The driver can be compiled
	  as module. It is an I2C driver, that exposes a V4L2
	  subdev for use by other drivers.

config VIDEO_SAMSUNG_S5P_SDO
	tristate "Samsung Analog TV Driver"
	depends on VIDEO_DEV && VIDEO_V4L2
	depends on VIDEO_SAMSUNG_S5P_TV
	help
	  Say Y here if you want support for the analog TV output
	  interface in S5P Samsung SoC. The driver can be compiled
	  as module. It is an auxiliary driver, that exposes a V4L2
	  subdev for use by other drivers. This driver requires
	  hdmiphy driver to work correctly.

config VIDEO_SAMSUNG_S5P_MIXER
	tristate "Samsung Mixer and Video Processor Driver"
	depends on VIDEO_DEV && VIDEO_V4L2
	depends on VIDEO_SAMSUNG_S5P_TV
	select VIDEOBUF2_DMA_CONTIG
	select VIDEOBUF2_FB
	help
	  Say Y here if you want support for the Mixer in Samsung S5P SoCs.
	  This device produce image data to one of output interfaces.

config VIDEO_SAMSUNG_S5P_MIXER_DEBUG
	bool "Enable debug for Mixer Driver"
	depends on VIDEO_SAMSUNG_S5P_MIXER
	default n
	help
	  Enables debugging for Mixer driver.

config ODROID_X_X2_BYPASS_HDMI_JUMPER
	bool "Ignores the HDMI Jumper on ODROID-X/X2 and set the res based on boot args"
	depends on ODROID_X || ODROID_X2
	default n
	help
		only set this if you are sure what you are doing

config ODORID_HDMI_SW_CONFIG
	bool "Ignores the HDMI Jumper and sets custom resolutions besides 1080 and 720"
	default y
	help
		Under Testing
endif # VIDEO_SAMSUNG_S5P_TV
```

## drivers/video/mali/Kconfig
```kconfig
config VIDEO_MALI_R3P2
	bool "User Mali r3p2 Driver (Mali and UMP)"
	default n
	help
	  Use Mali r3p2


if VIDEO_MALI_R3P2
	source "drivers/video/mali/r3p2/mali/Kconfig"
	source "drivers/video/mali/r3p2/ump/Kconfig"
endif
```
