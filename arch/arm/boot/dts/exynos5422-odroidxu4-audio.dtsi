/*
 * Hardkernel Odroid XU3 Audio Codec device tree source
 *
 * Copyright (c) 2015 Krzysztof Kozlowski
 * Copyright (c) 2014 Collabora Ltd.
 * Copyright (c) 2013 Samsung Electronics Co., Ltd.
 *		http://www.samsung.com
 *
 * This program is free software; you can redistribute it and/or modify
 * it under the terms of the GNU General Public License version 2 as
 * published by the Free Software Foundation.
*/

/ {
	dummy_codec: spdif-transmitter {
		compatible = "linux,spdif-dit";
		status = "okay";
	};
	sound: sound {
		compatible = "hardkernel,odroid-max98090";
		card-name = "odroid-snd";
		clocks = <&clock CLK_FOUT_EPLL>,
			<&clock CLK_MOUT_EPLL>,
			<&clock CLK_MOUT_MAU_EPLL>,
			<&clock CLK_MOUT_USER_MAU_EPLL>,
			<&clock_audss EXYNOS_MOUT_AUDSS>,
			<&clock_audss EXYNOS_MOUT_I2S>,
			<&clock_audss EXYNOS_DOUT_SRP>,
			<&clock_audss EXYNOS_DOUT_AUD_BUS>,
			<&clock CLK_MAU_EPLL>;
		clock-names = "fout_epll", "mout_sclk_epll",
			"mout_mau_epll","mout_mau_epll_user",
			"mout_audss", "mout_i2s",
			"dout_srp","dout_aud_bus",
			"mau_epll_clk";
		samsung,i2s-controller = <&i2s0 0>;
		samsung,audio-codec = <&dummy_codec>;
		codec-dai-name = "dit-hifi";
	};
};

&i2s0 {
	status = "okay";
};
