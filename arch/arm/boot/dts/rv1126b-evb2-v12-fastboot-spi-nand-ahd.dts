// SPDX-License-Identifier: (GPL-2.0+ OR MIT)
/*
 * Copyright (c) 2026 Rockchip Electronics Co., Ltd.
 */

#include "arm64/rockchip/rv1126b-evb2-v12-fastboot-spi-nand-ahd.dts"

/ {
	model = "Rockchip RV1126B EVB2 V12 SPI-NAND AHD Fastboot Board";
	compatible = "rockchip,rv1126b-evb2-v12-fastboot-spi-nand-ahd",
		     "rockchip,rv1126b";

	chosen {
		bootargs = "loglevel=0 initcall_debug=0 earlycon=uart8250,mmio32,0x20810000 console=ttyFIQ0 root=/dev/rd0 rootfstype=erofs rootflags=dax snd_soc_core.prealloc_buffer_size_kbytes=16 coherent_pool=32K";
	};
};
