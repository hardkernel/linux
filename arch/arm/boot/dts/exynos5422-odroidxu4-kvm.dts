/*
 * Hardkernel Odroid XU4 board device tree source for KVM
 *
 * Copyright (c) 2017 Hardkernel Co., Ltd.
 *
 * This program is free software; you can redistribute it and/or modify
 * it under the terms of the GNU General Public License version 2 as
 * published by the Free Software Foundation.
 */

#include "exynos5422-odroidxu4.dts"

/ {
	timer {
		compatible = "arm,cortex-a15-timer",
			   "arm,armv7-timer";
		interrupts = <1 13 0xf08>,
			   <1 14 0xf08>,
			   <1 11 0xf08>,
			   <1 10 0xf08>;
		clock-frequency = <24000000>;
	};
	
	fixed-rate-clocks {
		oscclk {
			compatible = "samsung,exynos5420-oscclk";
			clock-frequency = <24000000>;
		};
	};
};