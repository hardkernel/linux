/dts-v1/;
/plugin/;

/ {
	fragment@0 {
		// i2c2 aliased with i2c0.
		target = <&i2c2>;

		__overlay__ {
			status = "okay";

			#address-cells = <1>;
			#size-cells = <0>;

			pcf8563: rtc@51 {
				status = "okay";
				compatible = "nxp,pcf8563";
				reg = <0x51>;
			};
		};
	};
};
