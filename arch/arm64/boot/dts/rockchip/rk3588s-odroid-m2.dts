// SPDX-License-Identifier: (GPL-2.0+ OR MIT)
/*
 * Copyright (c) 2024 Hardkernel Co., Ltd.
 *
 */

/dts-v1/;

#include <dt-bindings/gpio/gpio.h>
#include <dt-bindings/pwm/pwm.h>
#include <dt-bindings/pinctrl/rockchip.h>
#include <dt-bindings/display/drm_mipi_dsi.h>
#include <dt-bindings/display/rockchip_vop.h>
#include <dt-bindings/sensor-dev.h>
#include <dt-bindings/usb/pd.h>

#include "rk3588s-odroid-m2-power.dtsi"
#include "rk3588s-odroid-m2.dtsi"
#include "rk3588-linux.dtsi"

/ {
	model = "Hardkernel ODROID-M2";
	compatible = "hardkernel,odroid-m2", "rockchip,rk3588";
};
