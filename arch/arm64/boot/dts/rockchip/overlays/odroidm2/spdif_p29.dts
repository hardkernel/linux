/dts-v1/;
/plugin/;

/ {
	fragment@0 {
		target = <&spdif_tx_sound>;

		__overlay__ {
			status = "okay";
			simple-audio-card,cpu {
				sound-dai = <&spdif_tx1>;
			};
		};
	};

	fragment@1 {
		target = <&spdif_tx_dc>;

		__overlay__ {
			status = "okay";
		};
	};

	fragment@2 {
		target = <&spdif_tx1>;

		__overlay__ {
			status = "okay";
		};
	};
};
