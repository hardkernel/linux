/dts-v1/;
/plugin/;

/ {
	fragment@0 {
		target = <&rknpu>;

		__overlay__ {
			rknpu-supply = <&vdd_npu_s0>;
			mem-supply = <&vdd_npu_mem_s0>;
			status = "okay";
		};
	};

	fragment@1 {
		target = <&rknpu_mmu>;

		__overlay__ {
			status = "okay";
		};
	};
};
