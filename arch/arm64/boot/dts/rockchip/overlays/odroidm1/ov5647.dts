/dts-v1/;
/plugin/;

#include "ov5647.dtsi"

/ {
	fragment@6 {
		// i2c2, i2c@fe5b0000
		target = <&i2c2>;

		__overlay__ {
			ov5647: ov5647@36 {
				rockchip,camera-module-name = "THDS11073";
				rockchip,camera-module-lens-name = "Largan-40122a1";
			};
		};
	};
};
