// SPDX-License-Identifier: (GPL-2.0+ OR MIT)
/*
 * Copyright (c) 2021 Hardkernel Co., Ltd.
 *
 */

/dts-v1/;
/plugin/;

/ {
	fragment@0 {
		target = <&fiq_debugger>;

		__overlay__ {
			rockchip,baudrate = <115200>;
		};
	};
};
