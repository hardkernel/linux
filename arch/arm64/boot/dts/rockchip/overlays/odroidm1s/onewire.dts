/dts-v1/;
/plugin/;

#include <dt-bindings/gpio/gpio.h>
#include <dt-bindings/pinctrl/rockchip.h>

/ {
	fragment@0 {
		target-path = "/";

		__overlay__ {
				onewire:onewire {
					compatible = "w1-gpio";
					gpios = <&gpio0 RK_PC2 GPIO_ACTIVE_HIGH>;
					status = "okay";
			};
		};
	};
};
